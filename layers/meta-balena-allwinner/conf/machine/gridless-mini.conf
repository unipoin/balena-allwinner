## layers/meta-balena-allwinner/conf/machine/gridless-mini.conf
```bitbake
#@TYPE: Machine
#@NAME: GRIDLESS.mini
#@DESCRIPTION: Machine configuration for the H3-Core-Board, based
# on the Allwinner H3 CPU.

require conf/machine/include/sun8i.inc

KERNEL_DEVICETREE = "sun8i-h3-gridless-mini-B3E.dtb"
UBOOT_MACHINE = "gridless_mini_defconfig"
```
